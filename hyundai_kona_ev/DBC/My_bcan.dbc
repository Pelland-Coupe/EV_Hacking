VERSION ""

NS_ :

BS_:
BU_: BCM
BO_ 263 UNK_B107: 8 Vector__XXX
   SG_ NEW_SIGNAL_1 : 39|16@0+ (1,0) [0|255] "a" Vector__XXX

BO_ 272 SMK_B110: 8 Vector__XXX
   SG_ MAYBE_POWER_PRESSED : 0|8@1+ (1,0) [0|255] "" Vector__XXX
   SG_ MAYBE_POWER_STATUS : 16|8@1+ (1,0) [0|255] "" Vector__XXX

BO_ 273 SMK_B111: 8 Vector__XXX

BO_ 274 SMK_B112: 8 Vector__XXX
   SG_ UNK_STATUS : 23|8@0+ (1,0) [0|255] "" Vector__XXX

BO_ 275 SMK_B113: 8 Vector__XXX

BO_ 1025 SMK_B401: 8 Vector__XXX

BO_ 1296 SMK_B510: 8 Vector__XXX

BO_ 256 BCMMsg39: 8 BCM

BO_ 257 BCMMsg39835: 8 BCM

BO_ 258 BCMMsg3983569: 8 BCM

BO_ 259 BCMMsg3983569678: 8 BCM

BO_ 260 BCMMsg3983569678847: 8 BCM

BO_ 261 BCMMsg3983569678847745: 8 BCM

BO_ 262 BCMMsg3983569678847745186: 8 BCM

BO_ 263 BCMMsg3983569678847745186435: 8 BCM

BO_ 265 BCMMsg9: 8 BCM

BO_ 1024 BCMMsg9556: 8 BCM

CM_ BU_ BCM "Body control module - has messages on both P-CAN and B-CAN";
CM_ SG_ 274 UNK_STATUS "LSB flips every few seconds - heartbeat?";
CM_ BO_ 256 "Seen in powerup on bench";
CM_ BO_ 257 "Seen in powerup on bench";
CM_ BO_ 258 "Seen in powerup on bench";
CM_ BO_ 259 "Seen in powerup on bench";
CM_ BO_ 260 "Seen in powerup on bench";
CM_ BO_ 261 "Seen in powerup on bench";
CM_ BO_ 262 "Seen in powerup on bench";
CM_ BO_ 263 "Seen in powerup on bench";
CM_ BO_ 265 "Seen in powerup on bench";
CM_ BO_ 1024 "Seen in powerup on bench";
BA_DEF_ BO_ "GenMsgBackgroundColor" STRING ;
BA_DEF_ BO_ "GenMsgForegroundColor" STRING ;
BA_DEF_DEF_ "GenMsgBackgroundColor" "#ffffff";
BA_DEF_DEF_ "GenMsgForegroundColor" "#000000";
